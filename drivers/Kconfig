## drivers/led_strip/Kconfig.gpio
```kconfig
# Copyright (c) 2024 The ZMK Contributors
# SPDX-License-Identifier: MIT

DT_COMPAT_ZMK_GPIO_LED_STRIP := zmk,gpio-led-strip

config GPIO_LED_STRIP
    bool "GPIO RGB LED Strip Driver"
    default $(dt_compat_enabled,$(DT_COMPAT_ZMK_GPIO_LED_STRIP))
    depends on GPIO
    select LED_STRIP
    help
      Enable driver for GPIO RGB LED strips

config GPIO_LED_STRIP_INIT_PRIORITY
	int "Init priority for composite LED_Strip driver"
	default 91
```

## drivers/led_strip/gpio_rgb/Kconfig
```kconfig
# Copyright (c) 2024 The ZMK Contributors
# SPDX-License-Identifier: MIT

menuconfig GPIO_RGB_STRIP
    bool "GPIO RGB LED Strip Driver"
    default y
    depends on GPIO
    select LED_STRIP
    help
      Enable driver for GPIO RGB LED strips
```

## dts/bindings/led_strip/zmk,gpio-led-strip.yaml
```yaml
# Copyrish

description: |
  LED-strip driver using GPIO pins to drive R G and B, note there is no dimming with this driver

compatible: "zmk,gpio-led-strip"

properties:
  chain-length:
    type: int
    required: true
    description: |
      The number of devices in the daisy-chain.
  
child-binding:
  description: "Details of included led devices, it is expected each one will have 3 subdevices for r g and b in order"
  properties:
    led:
      type: phandle
      required: true
```
